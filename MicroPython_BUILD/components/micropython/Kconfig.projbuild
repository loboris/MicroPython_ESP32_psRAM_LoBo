## main/Kconfig.projbuild
```kconfig
menu "Template Plus"

choice
	prompt "MCU"
	config D0WDQ6
		bool "Dual core ESP32"
		help
			ESP32-D0WDQ6.
	config S0WD
		bool "Single core ESP32"
		help
			ESP32-S0WD.
endchoice
config MCU_TYPE
	int
    default 0 if D0WDQ6
    default 1 if S0WD
config MICROPY_HW_MCU_NAME
	string
	default "ESP32-D0WDQ6" if D0WDQ6
	default "ESP32-S0WD" if S0WD

choice
	prompt "Board"
	depends on D0WDQ6
	config ESP32D
		depends on D0WDQ6
		bool "Generic dual core ESP32"
		help
			It should work on any ESP32 board, your mileage may vary.
	config M5STACK
		depends on D0WDQ6
		bool "M5Stack Core Gen1"
		help
			M5Stack Core Gen1 board.
endchoice
choice
	prompt "Board"
	depends on S0WD
	config ESP32S
		depends on S0WD
		bool "Generic single core ESP32"
		help
			It should work on any ESP32 board, your mileage may vary.
endchoice
config BOARD_TYPE
	int
    default 0 if ESP32D
    default 1 if M5STACK
    default 2 if ESP32S
config MICROPY_HW_BOARD_NAME
	string
	default "Generic Dual Core ESP32" if ESP32D
	default "M5Stack Core Gen1" if M5STACK
	default "Generic Single Core ESP32" if ESP32S

config MICROPY_TIMEZONE
	string "Time zone"
    default "GMT0BST"
    help
    	Set the default time zone string used when updating the time from NTP server
        You can use 'components/micropython/docs/zones.csv'
        file to find the time zone string.
        Use the second entry for your Region/city as the value set here. Example:
        For Zagreb, the zones.csv file contains :"Europe/Zagreb","CET-1CEST,M3.5.0,M10.5.0/3".
        You should put "CET-1CEST,M3.5.0,M10.5.0/3" or "CET-1CEST" as Time zone.

menu "SD Card configuration"
	 	depends on ENABLE_MICROPYTHON
		config SDCARD_MODE
		    int
		    default 1 if SDCARD_MODE1
		    default 2 if SDCARD_MODE2
		    default 3 if SDCARD_MODE3
		
			choice
			    prompt "SD Card mode"
			    default SDCARD_MODE3
			    help
			        Select SD Card operating mode
			
			    config SDCARD_MODE1
			        bool "SPI Mode"
			        depends on !MEMMAP_SPIRAM_ENABLE 
			    config SDCARD_MODE2
			        bool "1-line SD Mode" 
			    config SDCARD_MODE3
			        bool "4-line SD Mode" 
			endchoice

        config SDCARD_CLK
            int "CLK pin"
            depends on SDCARD_MODE1
            range 1 32
            default 14
            help
            Pin used as SPI CLK

        config SDCARD_MOSI
            int "MOSI pin"
            depends on SDCARD_MODE1
            range 1 32
            default 15
            help
            Pin used as SPI MOSI

        config SDCARD_MISO
            int "MISO pin"
            depends on SDCARD_MODE1
            range 1 32
            default 2
            help
            Pin used as SPI MISO

        config SDCARD_CS
            int "CS pin"
            depends on SDCARD_MODE1
            range 1 32
            default 13
            help
            Pin used as SPI CS
endmenu
        
menu "File systems"
	 	depends on ENABLE_MICROPYTHON
        config MICROPY_FATFS_MAX_OPEN_FILES
            int "Maximum number of opened files"
            range 4 24
            default 6
            help
            Maximum number of opened files

        config MICROPY_USE_SPIFFS
            bool "Use SPIFFS"
            default y
            help
            Use spiffs on spi Flash instead of FatFS

        config MICROPY_SDMMC_SHOW_INFO
            bool "Show SDCard/InternalFS info"
            default y
            help
            Show info after initializing SD card or internal FS
endmenu

menuconfig ENABLE_WIFI
    bool "WiFi"
    select LWIP_SO_RCVBUF
    select ETHERNET
    select WIFI_ENABLED
    select ESP32_PHY_CALIBRATION_AND_DATA_STORAGE
    select MEMMAP_SMP
    default "n"
config WIFI_SSID
    string "WiFi ssid"
    default ""
	depends on ENABLE_WIFI
    help
        The SSID it will connect on boot.
config WIFI_PASSWORD
    string "WiFi password"
    default ""
	depends on ENABLE_WIFI
    help
        The SSID's password to connect.
config WIFI_AUTOCONNECT
    bool "Connect on boot"
	depends on ENABLE_WIFI
    default "n"
    help
        If enabled it will connect on boot to the specified network.

menuconfig ENABLE_OTA
    bool "Enable OTA"
    default "y"
    help
        Enabling this option will allocate the memory and create the task, 
        but the OTA server is suspended waiting for resume.
choice
	prompt "Select OTA mode"
	depends on ENABLE_OTA
	config OTA_PUSH
		bool "Push"
		help
			If selected a server will be executed and it will wait for updates.
	config OTA_PULL
		bool "Pull"
		help
			If selected the device will pull updates according to schedule or external commands.
endchoice
config OTA_MODE
	int
    default 0 if OTA_PUSH
    default 1 if OTA_PULL
	depends on ENABLE_OTA
config MICROPY_USE_OTA
        bool "Use OTA partition layout"
        default n
		depends on ENABLE_OTA
	 	depends on OTA_PULL
	 	depends on ENABLE_MICROPYTHON
        help
        	Use OTA partition layout and include OTA module into build
config GPIO_INPUT_FORCE_FACTORY
        bool "Use GPIO2 to force boot from Factory partition"
		depends on ENABLE_OTA
	 	depends on OTA_PULL
	 	depends on ENABLE_MICROPYTHON
		depends on MICROPY_USE_OTA
        default n
        help
        	If OTA layout is enabled and OTA update has been executed
        	the system will boot from one of the OTA partition
        	To force boot from Factory partition GPIO2 must be high for 3 seconds during boot
config AUTOSTART_OTA
    bool "Autostart OTA server on boot"
    default "n"
 	depends on ENABLE_OTA
	depends on OTA_PUSH
    help
        Enabling this option will resume the OTA server task.
        If disabled it stays suspended waiting for explicit resume.
choice
	prompt "Select core for OTA"
	depends on ENABLE_OTA
	depends on OTA_PUSH
	config OTA_CORE_0
		bool "Core 0"
		help
			If selected OTA will be executed by PRO Core.
	config OTA_CORE_1
		bool "Core 1"
    	select MEMMAP_SMP
		help
			If selected OTA will be executed by APP Core.
endchoice
config OTA_CORE
	int
    default 0 if OTA_CORE_0
    default 1 if OTA_CORE_1
	depends on ENABLE_OTA
	depends on OTA_PUSH

menuconfig ENABLE_ARDUINO
    bool "Enable Arduino"
    select MEMMAP_SMP
    default "y"
    help
		It allows to run applications based on Arduino libs. 
		If enabled initArduino() is called to run any preparations required by the framework, 
		memory allocated, the task is created and suspended.
choice
	prompt "Select app for Arduino"
	depends on ENABLE_ARDUINO
	config DEFAULTAPP
		bool "Default"
		help
			If selected the executed app will be the default one.
	config CUSTOMAPP
		bool "Custom"
		help
			If selected the executed app will be the one in the arduino folder.
	config BOTHAPP
		bool "Both"
		help
			If selected both the default and the arduino folder app will be executed.
endchoice
config ARDUINOAPP
	int
    default 0 if DEFAULTAPP
    default 1 if CUSTOMAPP
    default 2 if BOTHAPP
	depends on ENABLE_ARDUINO
config AUTOSTART_ARDUINO
    bool "Start Arduino loop on boot"
    default "n"
 	depends on ENABLE_ARDUINO
    help
        Enabling this option will resume the C/C++ app task, execute setup() and start the loop.
        If disabled the task stays suspended waiting for explicit resume.
choice
	prompt "Select core for Arduino"
	depends on ENABLE_ARDUINO
	config ARDUINO_CORE_0
		bool "Core 0"
		help
			If selected Arduino will be executed by PRO Core.
	config ARDUINO_CORE_1
		bool "Core 1"
		help
			If selected Arduino will be executed by APP Core.
endchoice
config ARDUINO_CORE
	int
    default 0 if ARDUINO_CORE_0
    default 1 if ARDUINO_CORE_1
	depends on ENABLE_ARDUINO
config DISABLE_HAL_LOCKS
    bool "Disable mutex locks for HAL"
    default "n"
	depends on ENABLE_ARDUINO
    help
        Enabling this option will run all hardware abstraction without locks.
        While communication with external hardware will be faster, you need to
        make sure that there is no option to use the same bus from another thread
        or interrupt at the same time. Option is best used with Arduino enabled
        and code implemented only in setup/loop and Arduino callbacks
menu "Debug Log Configuration"
	depends on ENABLE_ARDUINO
choice
    prompt "Default log level"
	depends on ENABLE_ARDUINO
	config ARDUHAL_LOG_DEFAULT_LEVEL_NONE
    	bool "No output"
	    help
			No output to logs.
	config ARDUHAL_LOG_DEFAULT_LEVEL_ERROR
    	bool "Error"
	    help
			Errors only.
	config ARDUHAL_LOG_DEFAULT_LEVEL_WARN
    	bool "Warning"
	    help
			Errors and Warnings.
	config ARDUHAL_LOG_DEFAULT_LEVEL_INFO
    	bool "Info"
	    help
	    	Errors, Warnings, Info.
	config ARDUHAL_LOG_DEFAULT_LEVEL_DEBUG
    	bool "Debug"
		help
	    	Errors, Warnings, Info, Debug.
	config ARDUHAL_LOG_DEFAULT_LEVEL_VERBOSE
    	bool "Everything"
	    help
	    	Everything.
endchoice
config ARDUHAL_LOG_DEFAULT_LEVEL
    int
    default 0 if ARDUHAL_LOG_DEFAULT_LEVEL_NONE
    default 1 if ARDUHAL_LOG_DEFAULT_LEVEL_ERROR
    default 2 if ARDUHAL_LOG_DEFAULT_LEVEL_WARN
    default 3 if ARDUHAL_LOG_DEFAULT_LEVEL_INFO
    default 4 if ARDUHAL_LOG_DEFAULT_LEVEL_DEBUG
    default 5 if ARDUHAL_LOG_DEFAULT_LEVEL_VERBOSE
	depends on ENABLE_ARDUINO
config ARDUHAL_LOG_COLORS
    bool "Use ANSI terminal colors in log output"
    default "n"
	depends on ENABLE_ARDUINO
    help
        Enable ANSI terminal color codes in bootloader output.
        In order to view these, your terminal program must support ANSI color codes.
config ARDUHAL_ESP_LOG
    bool "Forward ESP_LOGx to Arduino log output"
    default "n"
	depends on ENABLE_ARDUINO
    help
        This option will redefine the ESP_LOGx macros to Arduino's log_x macros.
        To enable for your application, add the follwing after your includes:
        #ifdef ARDUINO_ARCH_ESP32
        #include "esp32-hal-log.h"
        #endif
endmenu

menuconfig ENABLE_MICROPYTHON
	bool "Enable MicroPython"
	default "y"
	help
    	Enabling this option will allocate the memory and create the task
    	but it is suspended waiting for resume.

	config AUTOSTART_MICROPYTHON
	    bool "Autostart Micropython on boot"
	    default "y"
	 	depends on ENABLE_MICROPYTHON
	    help
    		Enabling this option will resume the Micropython task on boot.
        	If disabled it stays suspended waiting for explicit resume.

    menu "System settings"
	 	depends on ENABLE_MICROPYTHON
		config MICRO_PY_LOG_LEVEL
		    int
		    default 0 if MICRO_PY_LOG_LEVEL0
		    default 1 if MICRO_PY_LOG_LEVEL1
		    default 2 if MICRO_PY_LOG_LEVEL2
		    default 3 if MICRO_PY_LOG_LEVEL3
		    default 4 if MICRO_PY_LOG_LEVEL4
		    default 5 if MICRO_PY_LOG_LEVEL5
		
			choice
			    prompt "Set ESP32 log level"
			    default MICRO_PY_LOG_LEVEL2
			    help
			        Select Log (debug) level
			
			    config MICRO_PY_LOG_LEVEL0
			        bool "None"
			    config MICRO_PY_LOG_LEVEL1
			        bool "Error"
			    config MICRO_PY_LOG_LEVEL2
			        bool "Warning"
			    config MICRO_PY_LOG_LEVEL3
			        bool "Info"
			    config MICRO_PY_LOG_LEVEL4
			        bool "Debug"
			    config MICRO_PY_LOG_LEVEL5
			        bool "Verbose"
			endchoice

	    config MICROPY_RX_BUFFER_SIZE
	        int "RX buffer size"
	        range 256 4096
	        default 1080
	        help
	        Set the size of the stdin RX buffer in bytes
	        Minimum of 1080 bytes must be set if you want to use YModem module
	
	    config MICROPY_USE_TASK_WDT
	        bool "Enable WatchDog for MicroPython task"
	        default y
	        help
	        Enable system WatchDog to monitor MicroPython task 
	
	    config MICROPY_USE_BOTH_CORES
	        bool "Use both cores for MicroPython tasks"
	    	depends on !FREERTOS_UNICORE
	        default n
	        help
	        Run MicroPython tasks on both cores, if not selected MicroPython tasks are created pinned to one core 
	
	    config MICROPY_TASK_PRIORITY
	        int "Main task priority"
	        range 1 20
	        default 5
	        help
	        Set the priority of the main MicroPython task
	
	    config MICROPY_STACK_SIZE
	        int "MicroPython stack size (KB)"
	        range 8 32 if !SPIRAM_SUPPORT
	        range 8 64 if SPIRAM_SUPPORT
	        default 20
	        help
	        Set the size of the MicroPython stack in Kbytes.
	
	    config MICROPY_HEAP_SIZE
	        int "MicroPython heap size (KB)"
	        range 48 96 if !SPIRAM_SUPPORT
	        range 48 74 if !SPIRAM_SUPPORT && MICROPY_USE_CURL && MICROPY_USE_CURL_TLS
	        range 512 3584 if SPIRAM_SUPPORT
	        default 80 if !SPIRAM_SUPPORT
	        default 72 if !SPIRAM_SUPPORT && MICROPY_USE_CURL && MICROPY_USE_CURL_TLS
	        default 2048 if SPIRAM_SUPPORT
	        help
	        Set the size of the MicroPython heap in Kbytes
	        If SPIRAM is not used, heap is allocated from DRAM and setting the heap size too large
	        may result in insuficient heap for C services like mqtt, gsm, curl... 
	
	    config MICROPY_THREAD_MAX_THREADS
	        int "Maximum number of threads"
	        range 1 16
	        default 4
	        help
	        Set the maximum number of threads that can run simultaneosly

	    config MICROPY_THREAD_STACK_SIZE
	        int "Threads default stack size (KB)"
	        range 2 32
	        default 4
	        help
	        Set the default thread stack size.
	        Different stack size can be set when starting the thread
	
	    config MICROPY_USE_TELNET
	        bool "Enable Telnet server"
	        default y
	        help
	        Enable Telnet server and REPL over telnet

	    config MICROPY_USE_WEBSERVER
	        bool "Enable Web server (experimental)"
	        default n
	        help
	        Enable Web server (experimental)

	    config MICROPY_USE_FTPSERVER
	        bool "Enable Ftp server"
	        default y
	        help
	        Enable Ftp server

	    menu "FTP Server Configuration"
	        depends on MICROPY_USE_FTPSERVER

			config FTPSERVER_LOG_LEVEL
			    int
			    default 0 if FTPSERVER_LOG_LEVEL0
			    default 1 if FTPSERVER_LOG_LEVEL1
			    default 2 if FTPSERVER_LOG_LEVEL2
			    default 3 if FTPSERVER_LOG_LEVEL3
			    default 4 if FTPSERVER_LOG_LEVEL4
			
				choice
				    prompt "Set FTP Server log level"
				    default FTPSERVER_LOG_LEVEL1
				    help
				        Select Log (debug) level
				
				    config FTPSERVER_LOG_LEVEL0
				        bool "None"
				    config FTPSERVER_LOG_LEVEL1
				        bool "Error"
				    config FTPSERVER_LOG_LEVEL2
				        bool "Warning"
				    config FTPSERVER_LOG_LEVEL3
				        bool "Info"
				    config FTPSERVER_LOG_LEVEL4
				        bool "Debug"
				endchoice
	
		    config MICROPY_FTPSERVER_TIMEOUT
		        int "Ftp server connection timeout (seconds)"
		        range 60 3600
		        default 300
		        help
		        Disconnect ftp client if no activity for more than this timeout value

		    config MICROPY_FTPSERVER_BUFFER_SIZE
		        int "Transfer buffer size (bytes)"
		        range 512 10240
		        default 1024
		        help
		        	Transfer buffer size
		        	Larger buffer enables faster transfer
		endmenu	
    endmenu

    menu "Modules"
	 	depends on ENABLE_MICROPYTHON
	    config MICROPY_PY_FRAMEBUF
	        bool "Enable framebuffer"
	        default n
	        help
	        Include framebuffer module into build
	
	    config MICROPY_PY_USE_BTREE
	        bool "Include Btree"
	        default n
	        help
	        Include Btree module into build
	
	    config MICROPY_USE_WEBSOCKETS
	        bool "Use Websockets"
	        default n
	        help
	        Include websockets module into build
	
	    config MICROPY_USE_DISPLAY
	        bool "Use Display module"
	        default n
	        help
	        Include Display module into build
	        Display module includes support for various SPI TFT displays
	
	    config MICROPY_USE_EVE
	        bool "Use EVE display module"
	        default n
	        help
	        Include EVE display module into build
	        Display module includes support for EVE displays (FT80x, FT81x)
	
	    config MICROPY_USE_GSM
	        bool "Use GSM module"
	        depends on PPP_SUPPORT
	        default n
	        help
	        Include GSM module and PPPoS support into build
	
	    config MICROPY_USE_ETHERNET
	        bool "Use Ethernet module"
	        default n
	        help
	        Include Ethernet (network.LAN) module into build
	
	    config MICROPY_USE_MDNS
	        bool "Use mDNS module"
	        default y
	        help
	        Include mDNS module into build
	
	    config MICROPY_USE_CURL
	        bool "Use Curl module"
	        default n
	        help
	        Include CURL module into build
	        Using CURLmodule will add ~230 KB to your flash code size
	
	    config MICROPY_USE_CURL_TLS
	        bool "Enable TLS in Curl module"
	        depends on MICROPY_USE_CURL
	        default y if SPIRAM_SUPPORT
	        default n if !SPIRAM_SUPPORT
	        help
	        Enable SSL/TLS in CURL module
	        TLS support requires large amount RAM !
	        If SPIRAM is not used, MicroPython heap size should not be set larger than 72KB !
	
	    config MICROPY_USE_CURLFTP
	        bool "FTP support in Curl module"
	        depends on MICROPY_USE_CURL
	        default n
	        help
	        Include Ftp support in Curl module
	        Not including it may save ~24 KB of flash code space
	
	    config MICROPY_USE_MAIL
	        bool "MAIL support in Curl module"
	        depends on MICROPY_USE_CURL
	        default y
	        help
	        Include Mail support in Curl module
	        Mail support is based on 'quickmail' library which is licensed under GPL,
	        so you may want to exclude it from the build
	
	    config MICROPY_USE_SSH
	        bool "Use SSH module"
	        default n
	        help
	        Include SSH module into build
	        Using SSH module will add ~86 KB to your flash code size
	
	    config MICROPY_USE_MQTT
	        bool "Use Mqtt module"
	        default n
	        help
	        Include Mqtt module into build
	
	    menu "MQTT Configuration"
	        depends on MICROPY_USE_MQTT
		    config MQTT_PROTOCOL_311
		        bool "Use protocol version 3.1.1"
		        default y
		        help
			        Use protocol version 3.1.1
			        If not set, protocol version 3.1.0 is used

		    config MQTT_PRIORITY
		        int "MQTT task priority"
		        default MICROPY_TASK_PRIORITY
		        range 1 20
		        help
			        FreeRTOS task priority of the Mqtt task
			        Default is MicroPython task priority

		    config MQTT_BUFFER_SIZE_BYTE
		        int "MQTT send/receive buffer size"
		        default 256
		        range 256 2048
		        help
			        Send/Receive buffer size in bytes
			        More than buffer size bytes can be received...
			        Publish payload size is limited to this size.
			        Keep in mind that 4*CONFIG_MQTT_BUFFER_SIZE_BYTE queue buffer will also be created.

		    config MQTT_MAX_PAYLOAD_SIZE
		        int "MQTT max payload size"
		        default 2048
		        range MQTT_BUFFER_SIZE_BYTE 16384
		        help
			        Maximum payload size which can be received
			        If the payload size is larger, it will be truncated

			config MQTT_LOG_LEVEL
			    int
			    default 0 if MQTT_LOG_LEVEL0
			    default 1 if MQTT_LOG_LEVEL1
			    default 2 if MQTT_LOG_LEVEL2
			    default 3 if MQTT_LOG_LEVEL3
			    default 4 if MQTT_LOG_LEVEL4
			
				choice
				    prompt "Set Mqtt log level"
				    default MQTT_LOG_LEVEL1
				    help
				        Select Log (debug) level
				
				    config MQTT_LOG_LEVEL0
				        bool "None"
				    config MQTT_LOG_LEVEL1
				        bool "Error"
				    config MQTT_LOG_LEVEL2
				        bool "Warning"
				    config MQTT_LOG_LEVEL3
				        bool "Info"
				    config MQTT_LOG_LEVEL4
				        bool "Debug"
				endchoice

	    endmenu
	endmenu

endmenu
```
